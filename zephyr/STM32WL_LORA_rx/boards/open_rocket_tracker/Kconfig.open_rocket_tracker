## zephyr/STM32WL_LORA_rx/boards/open_rocket_tracker/Kconfig.open_rocket_tracker
```kconfig
config BOARD_OPEN_ROCKET_TRACKER
	bool "Open Rocket Tracker Board"
	select SOC_STM32WLE5XX

# LoRa Radio Configuration
config LORA_FREQUENCY
	int "LoRa Frequency (Hz)"
	default 915000000
	help
	  LoRa radio frequency in Hz.
	  Common values: 915000000 (915 MHz), 868000000 (868 MHz), 433000000 (433 MHz)

config LORA_BANDWIDTH
	int "LoRa Bandwidth (kHz)"
	default 125
	range 125 500
	help
	  LoRa signal bandwidth in kHz.
	  Valid values: 125, 250, 500
	  Lower bandwidth = longer range but slower data rate

config LORA_SPREADING_FACTOR
	int "LoRa Spreading Factor"
	default 12
	range 6 12
	help
	  LoRa spreading factor (SF6-SF12).
	  Higher SF = longer range but slower data rate.
	  SF12: Max range, ~250 bps
	  SF7:  Shorter range, ~5500 bps

config LORA_TX_POWER
	int "LoRa TX Power (dBm)"
	default 14
	range 2 22
	help
	  LoRa transmit power in dBm.
	  Higher power = longer range but more power consumption.

config RF_ENABLE_LED
	bool "Enable RF Activity LED"
	default y
	help
	  Enable LED indication for RF activity.
	  LED flashes when transmitting or receiving packets.
```

## zephyr/STM32WL_LORA_tx/boards/open_rocket_tracker/Kconfig.open_rocket_tracker
```kconfig
config BOARD_OPEN_ROCKET_TRACKER
	bool "Open Rocket Tracker Board"
	select SOC_STM32WLE5XX

# LoRa Radio Configuration
config LORA_FREQUENCY
	int "LoRa Frequency (Hz)"
	default 915000000
	help
	  LoRa radio frequency in Hz.
	  Common values: 915000000 (915 MHz), 868000000 (868 MHz), 433000000 (433 MHz)

config LORA_BANDWIDTH
	int "LoRa Bandwidth (kHz)"
	default 125
	range 125 500
	help
	  LoRa signal bandwidth in kHz.
	  Valid values: 125, 250, 500
	  Lower bandwidth = longer range but slower data rate

config LORA_SPREADING_FACTOR
	int "LoRa Spreading Factor"
	default 12
	range 6 12
	help
	  LoRa spreading factor (SF6-SF12).
	  Higher SF = longer range but slower data rate.
	  SF12: Max range, ~250 bps
	  SF7:  Shorter range, ~5500 bps

config LORA_TX_POWER
	int "LoRa TX Power (dBm)"
	default 14
	range 2 22
	help
	  LoRa transmit power in dBm.
	  Higher power = longer range but more power consumption.

config LORA_TX_INTERVAL_MS
	int "LoRa TX Interval (ms)"
	default 2000
	range 200 10000
	help
	  Interval between LoRa transmissions in milliseconds.
	  Lower values = faster updates but more power consumption.
	  With SF12: minimum ~1000ms recommended
	  With SF7:  can go as low as 200ms

config GNSS_UPDATE_RATE_HZ
	int "GNSS Update Rate (Hz)"
	range 1 10
	default 5
	help
	  Set the GNSS update rate in Hertz.  Valid values are 1-10.

config GNSS_AIRBORNE_4G_MODE
	bool "Enable GNSS Airborne <4g Mode"
	default y
	help
	  Enable the GNSS Airborne <4g dynamic model.

config GNSS_ENABLE_GGA
	bool "Enable GGA NMEA Message"
	default y
	help
	  Enable output of the GGA NMEA message.

config GNSS_ENABLE_GSV
	bool "Enable GSV NMEA Message"
	default y
	help
	  Enable output of the GSV NMEA message.

config GNSS_ENABLE_RMC
	bool "Enable RMC NMEA Message"
	default n
	help
	  Enable output of the RMC NMEA message.

config RF_ENABLE_LED
	bool "Enable RF Activity LED"
	default y
	help
	  Enable LED indication for RF activity.
	  LED flashes when transmitting or receiving packets.
```

## zephyr/boards/open_rocket_tracker/board.yml
```yaml
board:
  name: open_rocket_tracker
  full_name: ORCA Open Rocket Tracker
  vendor: ORCA
  socs:
    - name: stm32wle5xx
```
